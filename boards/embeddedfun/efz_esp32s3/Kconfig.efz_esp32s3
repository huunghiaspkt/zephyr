## boards/embeddedfun/efz_esp32s3/board.yml
```yaml
board:
  name: efz_esp32s3
  full_name: EFZ-ESP32S3
  vendor: embeddedfun
  socs:
  - name: esp32s3
```

## samples/efz_samples/01_how-to-start/hello_world/sample.yaml
```yaml
sample:
  name: Hello World
  description: "Print a greeting with the board name"
common:
  build_only: true
  tags: efz
  platform_allow:
    - efz_esp32s3/esp32s3/procpu
    - esp32s3_devkitc/esp32s3/procpu
  integration_platforms:
    - efz_esp32s3/esp32s3/procpu
    - esp32s3_devkitc/esp32s3/procpu
tests:
  sample.efz.hello_world:
    tags: efz
```

## samples/efz_samples/02_basic/thread_create/sample.yaml
```yaml
sample:
  name: Threads created with k_thread_create
  description: "The threads sample with its three threads created at runtime by main() using k_thread_create"
common:
  build_only: true
  tags: efz
  platform_allow:
    - efz_esp32s3/esp32s3/procpu
  integration_platforms:
    - efz_esp32s3/esp32s3/procpu
tests:
  sample.efz.thread_create:
    tags: efz
```

## samples/efz_samples/02_basic/threads_basic/sample.yaml
```yaml
sample:
  name: Threads basic
  description: "Two threads: a counter and the WS2812 LED pattern"
common:
  build_only: true
  tags: efz
  platform_allow:
    - efz_esp32s3/esp32s3/procpu
    - esp32s3_devkitc/esp32s3/procpu
  integration_platforms:
    - efz_esp32s3/esp32s3/procpu
    - esp32s3_devkitc/esp32s3/procpu
tests:
  sample.efz.threads_basic:
    tags: efz
```

## samples/efz_samples/02_basic/work_blink/sample.yaml
```yaml
sample:
  name: Blink an LED with a work item
  description: "A delayable work item toggles LED1 and reschedules itself, with no thread of its own"
common:
  build_only: true
  tags: efz
  platform_allow:
    - efz_esp32s3/esp32s3/procpu
  integration_platforms:
    - efz_esp32s3/esp32s3/procpu
tests:
  sample.efz.work_blink:
    tags: efz
```

## samples/efz_samples/02_basic/work_button/sample.yaml
```yaml
sample:
  name: Hand a button press to a work item
  description: "The BN1 interrupt submits a work item; the work item toggles LED2 and counts interrupts and runs"
common:
  build_only: true
  tags: efz
  platform_allow:
    - efz_esp32s3/esp32s3/procpu
  integration_platforms:
    - efz_esp32s3/esp32s3/procpu
tests:
  sample.efz.work_button:
    tags: efz
```

## samples/efz_samples/02_basic/ws2812/sample.yaml
```yaml
sample:
  name: WS2812 RGB LED
  description: "Cycle the on-board WS2812 RGB LED through colours"
common:
  build_only: true
  tags: efz
  platform_allow:
    - efz_esp32s3/esp32s3/procpu
    - esp32s3_devkitc/esp32s3/procpu
  integration_platforms:
    - efz_esp32s3/esp32s3/procpu
    - esp32s3_devkitc/esp32s3/procpu
tests:
  sample.efz.ws2812:
    tags: efz
```

## samples/efz_samples/03_intermediate/binding_yaml/sample.yaml
```yaml
sample:
  name: Binding YAML
  description: "A custom devicetree binding that drives a GPIO load switch"
common:
  build_only: true
  tags: efz
  platform_allow:
    - efz_esp32s3/esp32s3/procpu
    - esp32s3_devkitc/esp32s3/procpu
  integration_platforms:
    - efz_esp32s3/esp32s3/procpu
    - esp32s3_devkitc/esp32s3/procpu
tests:
  sample.efz.binding_yaml:
    tags: efz
```

## samples/efz_samples/03_intermediate/ble_basics/sample.yaml
```yaml
sample:
  name: BLE basics
  description: "Bluetooth LE peripheral with the Nordic UART Service"
common:
  build_only: true
  tags: efz
  platform_allow:
    - efz_esp32s3/esp32s3/procpu
    - esp32s3_devkitc/esp32s3/procpu
  integration_platforms:
    - efz_esp32s3/esp32s3/procpu
    - esp32s3_devkitc/esp32s3/procpu
tests:
  sample.efz.ble_basics:
    tags: efz
```

## samples/efz_samples/03_intermediate/custom_driver/app/sample.yaml
```yaml
sample:
  name: Custom driver
  description: "Out-of-tree blink driver with its own API and binding"
common:
  build_only: true
  tags: efz
  platform_allow:
    - efz_esp32s3/esp32s3/procpu
    - esp32s3_devkitc/esp32s3/procpu
  integration_platforms:
    - efz_esp32s3/esp32s3/procpu
    - esp32s3_devkitc/esp32s3/procpu
tests:
  sample.efz.custom_driver:
    tags: efz
```

## samples/efz_samples/03_intermediate/devicetree_tour/sample.yaml
```yaml
sample:
  name: Devicetree tour
  description: "Print what the devicetree says about the board at build time"
common:
  build_only: true
  tags: efz
  platform_allow:
    - efz_esp32s3/esp32s3/procpu
    - esp32s3_devkitc/esp32s3/procpu
  integration_platforms:
    - efz_esp32s3/esp32s3/procpu
    - esp32s3_devkitc/esp32s3/procpu
tests:
  sample.efz.devicetree_tour:
    tags: efz
```

## samples/efz_samples/03_intermediate/power_management/sample.yaml
```yaml
sample:
  name: Power management
  description: "Device runtime PM with a parent and child device"
common:
  build_only: true
  tags: efz
  platform_allow:
    - efz_esp32s3/esp32s3/procpu
    - esp32s3_devkitc/esp32s3/procpu
  integration_platforms:
    - efz_esp32s3/esp32s3/procpu
    - esp32s3_devkitc/esp32s3/procpu
tests:
  sample.efz.power_management:
    tags: efz
```

## samples/efz_samples/03_intermediate/threads_sync/sample.yaml
```yaml
sample:
  name: Thread synchronisation
  description: "Mutex, semaphore and message queue between threads"
common:
  build_only: true
  tags: efz
  platform_allow:
    - efz_esp32s3/esp32s3/procpu
    - esp32s3_devkitc/esp32s3/procpu
  integration_platforms:
    - efz_esp32s3/esp32s3/procpu
    - esp32s3_devkitc/esp32s3/procpu
tests:
  sample.efz.threads_sync:
    tags: efz
```

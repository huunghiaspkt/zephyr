## sample.yaml
```
sample:
  name: Wi-Fi shell
  description: "Scan, connect and ping over the Zephyr shell"
common:
  build_only: true
  tags: efz
  platform_allow:
    - efz_esp32s3/esp32s3/procpu
    - esp32s3_devkitc/esp32s3/procpu
  integration_platforms:
    - efz_esp32s3/esp32s3/procpu
    - esp32s3_devkitc/esp32s3/procpu
tests:
  sample.efz.wifi_shell:
    tags: efz
```

## prj.conf
```kconfig
# Shell subsystem 
# NET_SHELL / NET_L2_WIFI_SHELL select CONFIG_SHELL themselves, but we
# set it explicitly so the dependency is obvious.
CONFIG_SHELL=y

# Networking stack
CONFIG_NETWORKING=y
CONFIG_NET_IPV4=y
CONFIG_NET_IPV6=n
CONFIG_NET_TCP=y
CONFIG_NET_UDP=y
CONFIG_NET_DHCPV4=y

CONFIG_NET_MAX_CONTEXTS=10
CONFIG_NET_PKT_RX_COUNT=10
CONFIG_NET_PKT_TX_COUNT=10
CONFIG_NET_BUF_RX_COUNT=20
CONFIG_NET_BUF_TX_COUNT=20
CONFIG_NET_TX_STACK_SIZE=2048
CONFIG_NET_RX_STACK_SIZE=2048

# Shell modules
CONFIG_NET_SHELL=y
CONFIG_NET_L2_WIFI_SHELL=y

# WiFi: generic API + the ESP32 driver 
CONFIG_WIFI=y
CONFIG_WIFI_ESP32=y
CONFIG_WIFI_LOG_LEVEL_ERR=y

# net_mgmt event queue
CONFIG_NET_MGMT_EVENT_QUEUE_TIMEOUT=5000
CONFIG_NET_MGMT_EVENT_QUEUE_SIZE=16

# Logging + stacks
CONFIG_LOG=y
CONFIG_NET_LOG=y
CONFIG_MAIN_STACK_SIZE=5200
CONFIG_SHELL_STACK_SIZE=5200
```

## src/main.c
```c
/*
 * Copyright (c) 2026 EmbeddedFun
 *
 * SPDX-License-Identifier: Apache-2.0
 *
 * Shell commands: WiFi + ping
 *
 * Try:  wifi scan | wifi connect -s "<ssid>" -p <psk> -k 1 | net ping <ip>
 */

#include <stdio.h>

#include <zephyr/kernel.h>

int main(void)
{
    printf("Hello EmbeddedFun!\n");
	printf("Zephyr shell ready.\n");
	printf("Try:  wifi scan  |  wifi connect -s <ssid> -p <psk> -k 1  |  net ping 8.8.8.8\n");
	return 0;
}
```

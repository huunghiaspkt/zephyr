## CMakeLists.txt
```
# SPDX-License-Identifier: Apache-2.0

cmake_minimum_required(VERSION 3.20.0)
find_package(Zephyr REQUIRED HINTS $ENV{ZEPHYR_BASE})
project(wakeup_over_uart LANGUAGES C)

target_sources(app PRIVATE
	src/main.c
	src/ble_bridge.c
	src/uart_bridge.c
)
target_include_directories(app PRIVATE src)
```

## Kconfig
```
# SPDX-License-Identifier: Apache-2.0

mainmenu "Wake up over UART sample"

config APP_READY_BYTE
	hex "READY token the device sends to the host"
	range 0x0 0xff
	default 0x06
	help
	  Sent once to the host after a phone connects and subscribes, meaning
	  "you may start streaming data now".

config APP_ADV_TIMEOUT_MS
	int "No-phone window before sleeping (ms)"
	default 30000
	help
	  After waking, advertise for this long. If no phone connects, go back to
	  System OFF instead of advertising forever.

config APP_UART_IDLE_MS
	int "UART-idle window before sleeping (ms)"
	default 5000
	help
	  While streaming, if the host sends nothing for this long, disconnect the
	  phone and go back to System OFF.

source "Kconfig.zephyr"
```

## sample.yaml
```
sample:
  name: Wake up over UART
  description: "Wake on a UART byte, bridge host data to a phone over BLE, sleep when idle"
common:
  sysbuild: true
  build_only: true
  integration_platforms:
    - nrf52840dk/nrf52840
tests:
  sample.wakeup_over_uart:
    platform_allow:
      - nrf52840dk/nrf52840
```

## prj.conf
```kconfig
# SPDX-License-Identifier: Apache-2.0

CONFIG_LOG=y

CONFIG_BT=y
CONFIG_BT_PERIPHERAL=y
CONFIG_BT_DEVICE_NAME="Wakeup-UART"
CONFIG_BT_NUS=y

CONFIG_BT_L2CAP_TX_MTU=247
CONFIG_BT_BUF_ACL_TX_SIZE=251
CONFIG_BT_BUF_ACL_RX_SIZE=251
CONFIG_BT_CTLR_DATA_LENGTH_MAX=251
CONFIG_BT_USER_DATA_LEN_UPDATE=y
CONFIG_BT_AUTO_DATA_LEN_UPDATE=y

CONFIG_SERIAL=y
CONFIG_UART_ASYNC_API=y
CONFIG_UART_0_ASYNC=y
CONFIG_UART_0_INTERRUPT_DRIVEN=n

CONFIG_USE_SEGGER_RTT=y
CONFIG_LOG_BACKEND_RTT=y
CONFIG_LOG_BACKEND_UART=n
CONFIG_UART_CONSOLE=n

CONFIG_GPIO=y
CONFIG_POWEROFF=y
CONFIG_PM_DEVICE=y
```

## src/main.c
```c
/*
 * SPDX-License-Identifier: Apache-2.0
 *
 * Author: EmbeddedFun <huunghiaspkt@gmail.com>
 *
 * wakeup_over_uart -- a tiny "wake on UART, bridge to a phone, sleep when idle"
 * demo for the nRF52840.
 *
 * The story it tells:
 *   1. The board sleeps in System OFF, drawing almost nothing.
 *   2. The host sends 0x00 over UART. That byte's start bit pulls the RX line
 *      low, which the chip senses as a wake and boots the firmware.
 *   3. The firmware advertises. A phone app connects and subscribes.
 *   4. The firmware sends a READY byte back to the host ("you may stream now").
 *   5. Every byte the host sends over UART is forwarded to the phone.
 *   6. If the host goes quiet for 5 s (no UART data), the board goes back to
 *      sleep. If no phone connects within 30 s of waking, it also sleeps.
 */
#include <zephyr/kernel.h>
#include <zephyr/logging/log.h>
#include <zephyr/sys/atomic.h>

#include <zephyr/device.h>
#include <zephyr/drivers/gpio.h>
#include <zephyr/pm/device.h>
#include <zephyr/sys/poweroff.h>

#include "ble_bridge.h"
#include "uart_bridge.h"

LOG_MODULE_REGISTER(main, LOG_LEVEL_INF);
#define WAKE_PORT DT_NODELABEL(gpio0)
#define WAKE_PIN  8
static const struct device *const wake_port = DEVICE_DT_GET(WAKE_PORT);

enum event {
	EV_SUBSCRIBED, 
	EV_DISCONNECTED,
	EV_NO_PHONE,
	EV_UART_IDLE,
};
K_MSGQ_DEFINE(events, sizeof(uint8_t), 8, 1);
static atomic_t forwarding;

static void post(enum event ev)
{
	uint8_t e = (uint8_t)ev;

	(void)k_msgq_put(&events, &e, K_NO_WAIT);
}

static void no_phone_expiry(struct k_timer *t)  { ARG_UNUSED(t); post(EV_NO_PHONE); }
static void uart_idle_expiry(struct k_timer *t) { ARG_UNUSED(t); post(EV_UART_IDLE); }
K_TIMER_DEFINE(no_phone_timer, no_phone_expiry, NULL);
K_TIMER_DEFINE(uart_idle_timer, uart_idle_expiry, NULL);

static inline void uart_idle_restart(void)
{
	k_timer_start(&uart_idle_timer, K_MSEC(CONFIG_APP_UART_IDLE_MS), K_NO_WAIT);
}

static void on_uart_bytes(const uint8_t *data, uint16_t len)
{
	if (atomic_get(&forwarding)) {
		ble_bridge_send(data, len);
		uart_idle_restart();
	}
}

static void on_ble_event(enum ble_bridge_event ev)
{
	switch (ev) {
	case BLE_BRIDGE_CONNECTED:
		k_timer_stop(&no_phone_timer);
		break;
	case BLE_BRIDGE_SUBSCRIBED:
		post(EV_SUBSCRIBED);
		break;
	case BLE_BRIDGE_DISCONNECTED:
		post(EV_DISCONNECTED);
		break;
	}
}

static void go_to_sleep(void)
{
	const struct device *host = DEVICE_DT_GET(DT_NODELABEL(uart0));

	LOG_INF("going to System OFF -- send 0x00 over UART to wake");

	atomic_clear(&forwarding);
	k_timer_stop(&uart_idle_timer);

	(void)pm_device_action_run(host, PM_DEVICE_ACTION_SUSPEND);
	(void)gpio_pin_configure(wake_port, WAKE_PIN, GPIO_INPUT | GPIO_PULL_UP);
	(void)gpio_pin_interrupt_configure(wake_port, WAKE_PIN, GPIO_INT_LEVEL_LOW);

	sys_poweroff();
}

static void supervisor(void *a, void *b, void *c)
{
	ARG_UNUSED(a);
	ARG_UNUSED(b);
	ARG_UNUSED(c);

	for (;;) {
		uint8_t ev;

		k_msgq_get(&events, &ev, K_FOREVER);

		switch (ev) {
		case EV_SUBSCRIBED:
			LOG_INF("phone ready -> forwarding UART to BLE");
			(void)uart_bridge_send_ready();
			atomic_set(&forwarding, 1);
			uart_idle_restart();
			break;

		case EV_UART_IDLE:
			LOG_INF("no UART data for %d ms", CONFIG_APP_UART_IDLE_MS);
			atomic_clear(&forwarding);
			ble_bridge_disconnect();
			break;

		case EV_NO_PHONE:
			LOG_INF("no phone connected within %d ms", CONFIG_APP_ADV_TIMEOUT_MS);
			go_to_sleep();
			break;

		case EV_DISCONNECTED:
			go_to_sleep();
			break;
		}
	}
}

K_THREAD_DEFINE(supervisor_tid, 2048, supervisor, NULL, NULL, NULL, 6, 0, 0);

int main(void)
{

	LOG_INF("Example: wakeup over UART");

	if (!device_is_ready(wake_port)) {
		LOG_ERR("wake GPIO port not ready");
	}

	if (ble_bridge_init(on_ble_event) != 0) {
		LOG_ERR("BLE init failed");
	}
	if (uart_bridge_init(on_uart_bytes) != 0) {
		LOG_ERR("UART init failed");
	}

	k_timer_start(&no_phone_timer, K_MSEC(CONFIG_APP_ADV_TIMEOUT_MS), K_NO_WAIT);

	return 0;
}
```

## src/ble_bridge.c
```c
/*
 * SPDX-License-Identifier: Apache-2.0
 *
 * Author: EmbeddedFun <huunghiaspkt@gmail.com>
 */
#include "ble_bridge.h"

#include <errno.h>
#include <string.h>

#include <zephyr/kernel.h>
#include <zephyr/logging/log.h>
#include <zephyr/sys/atomic.h>
#include <zephyr/sys/util.h>

#include <zephyr/bluetooth/bluetooth.h>
#include <zephyr/bluetooth/conn.h>
#include <zephyr/bluetooth/gatt.h>
#include <zephyr/bluetooth/hci_types.h>

#include <bluetooth/services/nus.h>

LOG_MODULE_REGISTER(ble_bridge, LOG_LEVEL_INF);

#define DEVICE_NAME     CONFIG_BT_DEVICE_NAME
#define DEVICE_NAME_LEN (sizeof(DEVICE_NAME) - 1)

#define ATT_NOTIFY_OVERHEAD 3
#define MAX_CHUNK 244

struct tx_chunk {
	uint16_t len;
	uint8_t data[MAX_CHUNK];
};
K_MSGQ_DEFINE(tx_msgq, sizeof(struct tx_chunk), 16, 4);

static struct bt_conn *current_conn;
static atomic_t notify_enabled;
static ble_bridge_observer_t observer;

static const struct bt_data ad[] = {
	BT_DATA_BYTES(BT_DATA_FLAGS, (BT_LE_AD_GENERAL | BT_LE_AD_NO_BREDR)),
	BT_DATA(BT_DATA_NAME_COMPLETE, DEVICE_NAME, DEVICE_NAME_LEN),
};

static const struct bt_data sd[] = {
	BT_DATA_BYTES(BT_DATA_UUID128_ALL, BT_UUID_NUS_VAL),
};

static void advertising_start(void)
{
	int err = bt_le_adv_start(BT_LE_ADV_CONN_FAST_2, ad, ARRAY_SIZE(ad),
				  sd, ARRAY_SIZE(sd));
	if (err) {
		LOG_ERR("advertising start failed (%d)", err);
		return;
	}
	LOG_INF("advertising as \"%s\"", DEVICE_NAME);
}

static void connected(struct bt_conn *conn, uint8_t err)
{
	if (err) {
		LOG_ERR("connection failed (0x%02x)", err);
		return;
	}
	current_conn = bt_conn_ref(conn);
	LOG_INF("phone connected");
	if (observer) {
		observer(BLE_BRIDGE_CONNECTED);
	}
}

static void disconnected(struct bt_conn *conn, uint8_t reason)
{
	ARG_UNUSED(conn);
	LOG_INF("phone disconnected (0x%02x)", reason);
	atomic_clear(&notify_enabled);
	if (current_conn) {
		bt_conn_unref(current_conn);
		current_conn = NULL;
	}
	if (observer) {
		observer(BLE_BRIDGE_DISCONNECTED);
	}
}

static void nus_send_enabled(enum bt_nus_send_status status)
{
	bool on = (status == BT_NUS_SEND_STATUS_ENABLED);

	atomic_set(&notify_enabled, on ? 1 : 0);
	LOG_INF("notifications %s", on ? "enabled" : "disabled");
	if (on && observer) {
		observer(BLE_BRIDGE_SUBSCRIBED);
	}
}

BT_CONN_CB_DEFINE(conn_callbacks) = {
	.connected = connected,
	.disconnected = disconnected,
};

static struct bt_nus_cb nus_cb = {
	.send_enabled = nus_send_enabled,
};

void ble_bridge_send(const uint8_t *data, uint16_t len)
{
	while (len > 0) {
		struct tx_chunk chunk;

		chunk.len = MIN(len, (uint16_t)MAX_CHUNK);
		memcpy(chunk.data, data, chunk.len);

		if (k_msgq_put(&tx_msgq, &chunk, K_NO_WAIT) != 0) {
			LOG_WRN("BLE TX queue full; dropping %u B", chunk.len);
			return;
		}
		data += chunk.len;
		len -= chunk.len;
	}
}

void ble_bridge_disconnect(void)
{
	if (current_conn) {
		(void)bt_conn_disconnect(current_conn, BT_HCI_ERR_REMOTE_USER_TERM_CONN);
	}
}

static void tx_thread(void *p1, void *p2, void *p3)
{
	ARG_UNUSED(p1);
	ARG_UNUSED(p2);
	ARG_UNUSED(p3);

	for (;;) {
		struct tx_chunk chunk;

		k_msgq_get(&tx_msgq, &chunk, K_FOREVER);

		if (current_conn == NULL || !atomic_get(&notify_enabled)) {
			continue;
		}

		int retries = 10;
		int err;

		do {
			err = bt_nus_send(current_conn, chunk.data, chunk.len);
			if (err == -ENOMEM) {
				k_msleep(2);
			}
		} while (err == -ENOMEM && --retries > 0);

		if (err) {
			LOG_WRN("nus_send %u B failed (%d)", chunk.len, err);
		}
	}
}

K_THREAD_DEFINE(nus_tx_tid, 1024, tx_thread, NULL, NULL, NULL, 7, 0, 0);

int ble_bridge_init(ble_bridge_observer_t obs)
{
	int err;

	observer = obs;

	err = bt_enable(NULL);
	if (err) {
		LOG_ERR("bt_enable failed (%d)", err);
		return err;
	}

	err = bt_nus_init(&nus_cb);
	if (err) {
		LOG_ERR("bt_nus_init failed (%d)", err);
		return err;
	}

	advertising_start();
	return 0;
}
```

## src/ble_bridge.h
```c
/*
 * SPDX-License-Identifier: Apache-2.0
 *
 * Author: EmbeddedFun <huunghiaspkt@gmail.com>
 *
 */
#ifndef BLE_BRIDGE_H_
#define BLE_BRIDGE_H_

#include <stdint.h>

enum ble_bridge_event {
	BLE_BRIDGE_CONNECTED,
	BLE_BRIDGE_SUBSCRIBED,
	BLE_BRIDGE_DISCONNECTED,
};

typedef void (*ble_bridge_observer_t)(enum ble_bridge_event ev);

int ble_bridge_init(ble_bridge_observer_t observer);

void ble_bridge_send(const uint8_t *data, uint16_t len);

void ble_bridge_disconnect(void);

#endif /* BLE_BRIDGE_H_ */
```

## src/uart_bridge.c
```c
/*
 * SPDX-License-Identifier: Apache-2.0
 *
 * Author: EmbeddedFun <huunghiaspkt@gmail.com>
 */
#include "uart_bridge.h"

#include <errno.h>

#include <zephyr/device.h>
#include <zephyr/drivers/uart.h>
#include <zephyr/kernel.h>
#include <zephyr/logging/log.h>

LOG_MODULE_REGISTER(uart_bridge, LOG_LEVEL_INF);

#define RX_BUF_SIZE   64
#define RX_TIMEOUT_US 2000
#define TX_TIMEOUT_US 10000

static const struct device *host_dev;
static uart_bridge_sink_t sink;

static uint8_t rx_buf[2][RX_BUF_SIZE];
static uint8_t next_buf;

static uint8_t ready_byte = CONFIG_APP_READY_BYTE;

static void uart_cb(const struct device *dev, struct uart_event *evt, void *user_data)
{
	ARG_UNUSED(user_data);

	switch (evt->type) {
	case UART_RX_RDY:
		if (sink) {
			sink(&evt->data.rx.buf[evt->data.rx.offset], evt->data.rx.len);
		}
		break;

	case UART_RX_BUF_REQUEST:
		(void)uart_rx_buf_rsp(dev, rx_buf[next_buf], RX_BUF_SIZE);
		next_buf ^= 1;
		break;

	case UART_RX_DISABLED:
		next_buf = 1;
		(void)uart_rx_enable(dev, rx_buf[0], RX_BUF_SIZE, RX_TIMEOUT_US);
		break;

	default:
		break;
	}
}

int uart_bridge_init(uart_bridge_sink_t uart_host)
{
	int rc;

	host_dev = DEVICE_DT_GET(DT_NODELABEL(uart0));
	if (!device_is_ready(host_dev)) {
		LOG_ERR("host UART not ready");
		return -ENODEV;
	}
	sink = uart_host;
	rc = uart_callback_set(host_dev, uart_cb, NULL);
	if (rc != 0) {
		LOG_ERR("uart_callback_set failed (%d)", rc);
		return rc;
	}

	next_buf = 1;
	rc = uart_rx_enable(host_dev, rx_buf[0], RX_BUF_SIZE, RX_TIMEOUT_US);
	if (rc != 0) {
		LOG_ERR("uart_rx_enable failed (%d)", rc);
		return rc;
	}

	LOG_INF("host UART up: forwarding received bytes to BLE");
	return 0;
}

int uart_bridge_send_ready(void)
{
	if (host_dev == NULL) {
		return -ENODEV;
	}
	LOG_INF("sending READY (0x%02x) to host", ready_byte);
	return uart_tx(host_dev, &ready_byte, 1, TX_TIMEOUT_US);
}
```

## src/uart_bridge.h
```c
/*
 * SPDX-License-Identifier: Apache-2.0
 *
 * Author: EmbeddedFun <huunghiaspkt@gmail.com>
 */

#ifndef UART_BRIDGE_H_
#define UART_BRIDGE_H_

#include <stdint.h>

typedef void (*uart_bridge_sink_t)(const uint8_t *data, uint16_t len);

int uart_bridge_init(uart_bridge_sink_t sink);

int uart_bridge_send_ready(void);

#endif /* UART_BRIDGE_H_ */
```

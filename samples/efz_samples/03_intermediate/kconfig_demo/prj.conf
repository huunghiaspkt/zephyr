## CMakeLists.txt
```
# SPDX-License-Identifier: Apache-2.0

cmake_minimum_required(VERSION 3.20.0)

find_package(Zephyr REQUIRED HINTS $ENV{ZEPHYR_BASE})
project(kconfig_demo)

target_sources(app PRIVATE src/main.c)
```

## Kconfig
```
# Per-application Kconfig — symbols listed here can be set in prj.conf
# or via west build -- -DCONFIG_FOO=y.
# SPDX-License-Identifier: Apache-2.0

mainmenu "kconfig_demo"

menu "Demo options"

config DEMO_GREETING
	string "Greeting printed at boot"
	default "Hello from Kconfig"
	help
	  Strings live in Kconfig too — they become CONFIG_* macros usable
	  in C with no quotes. See main.c for usage.

config DEMO_LOOP_PERIOD_MS
	int "Period of the demo loop in ms"
	default 1000
	range 100 5000
	help
	  Integer Kconfig — becomes a plain `int` constant in the binary.

config DEMO_USE_FANCY_OUTPUT
	bool "Use the fancy banner"
	default y
	help
	  Boolean Kconfig — guards an optional feature with IS_ENABLED().

endmenu

source "Kconfig.zephyr"
```

## sample.yaml
```
sample:
  name: Kconfig demo
  description: "Application Kconfig symbols read from C"
common:
  build_only: true
  tags: efz
  platform_allow:
    - efz_esp32s3/esp32s3/procpu
    - esp32s3_devkitc/esp32s3/procpu
  integration_platforms:
    - efz_esp32s3/esp32s3/procpu
    - esp32s3_devkitc/esp32s3/procpu
tests:
  sample.efz.kconfig_demo:
    tags: efz
```

## prj.conf
```kconfig
# Common prj.conf — values shared across all boards.
CONFIG_LOG=y

# App-defined symbols (see Kconfig in this directory).
CONFIG_DEMO_GREETING="Hello from EmbeddedFun"
CONFIG_DEMO_LOOP_PERIOD_MS=750
CONFIG_DEMO_USE_FANCY_OUTPUT=y
```

## boards/esp32s3_devkitc_procpu.conf
```kconfig
# Board-specific Kconfig overrides — merged ON TOP of prj.conf.
# Same filename pattern works for any board, e.g.
# boards/nrf52840dk_nrf52840.conf.
#
# Here we override the greeting for ESP32-S3 builds only.

CONFIG_DEMO_GREETING="Hello from boards/esp32s3_devkitc_procpu.conf"
CONFIG_DEMO_LOOP_PERIOD_MS=500
```

## src/main.c
```c
/*
 * Copyright (c) 2026 EmbeddedFun
 *
 * SPDX-License-Identifier: Apache-2.0
 *
 * kconfig_demo — shows how Kconfig values become C constants.
 *
 * Try each of these and watch the output change:
 *
 *   # Default greeting from prj.conf, overridden by boards/<board>.conf
 *   west build -b esp32s3_devkitc_procpu .
 *
 *   # Override on the command line — wins over both files.
 *   west build -b esp32s3_devkitc_procpu . -- \
 *       -DCONFIG_DEMO_GREETING='"Hello from CLI"' \
 *       -DCONFIG_DEMO_USE_FANCY_OUTPUT=n
 *
 *   # Inspect the final, merged Kconfig:
 *   cat build/zephyr/.config | grep DEMO_
 */

#include <zephyr/kernel.h>
#include <zephyr/logging/log.h>

LOG_MODULE_REGISTER(kconfig_demo, LOG_LEVEL_INF);

static void print_fancy(void)
{
	LOG_INF("==========================================");
	LOG_INF("  %s", CONFIG_DEMO_GREETING);
	LOG_INF("  loop period = %d ms", CONFIG_DEMO_LOOP_PERIOD_MS);
	LOG_INF("==========================================");
}

static void print_plain(void)
{
	LOG_INF("%s (period=%d ms)",
		CONFIG_DEMO_GREETING, CONFIG_DEMO_LOOP_PERIOD_MS);
}

int main(void)
{
	/* IS_ENABLED() is the canonical way to check a bool CONFIG_*.
	 * Both branches always compile — the dead one is dropped by the
	 * optimizer. Prefer this to #ifdef.
	 */
	if (IS_ENABLED(CONFIG_DEMO_USE_FANCY_OUTPUT)) {
		print_fancy();
	} else {
		print_plain();
	}

	while (1) {
		k_sleep(K_MSEC(CONFIG_DEMO_LOOP_PERIOD_MS));
		LOG_INF("tick");
	}
}
```
